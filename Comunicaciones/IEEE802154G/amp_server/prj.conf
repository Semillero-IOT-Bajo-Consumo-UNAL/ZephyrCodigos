## prj.conf
```kconfig
# --- Núcleo de red ---
CONFIG_NETWORKING=y
CONFIG_NET_UDP=y
CONFIG_NET_TCP=n
CONFIG_NET_IPV6=y
CONFIG_NET_IPV4=n
CONFIG_NET_SOCKETS=y
CONFIG_NET_SOCKETS_PACKET=y
CONFIG_POSIX_API=y
CONFIG_REQUIRES_FULL_LIBC=y
CONFIG_NET_SOCKETS_POLL_MAX=4

# --- Configuración de red ---
CONFIG_NET_CONFIG_SETTINGS=y
CONFIG_NET_CONNECTION_MANAGER=y
CONFIG_NET_CONFIG_NEED_IPV6=y
CONFIG_NET_CONFIG_MY_IPV6_ADDR="2001:db8::1"
CONFIG_NET_CONFIG_PEER_IPV6_ADDR="2001:db8::2"
CONFIG_NET_IF_MCAST_IPV6_ADDR_COUNT=5

# --- Capa IEEE 802.15.4 ---
CONFIG_NET_L2_IEEE802154=y
CONFIG_IEEE802154=y

# Canal y PAN ID (canal sub-GHz según tabla 802.15.4g para tu región)
CONFIG_NET_CONFIG_IEEE802154_CHANNEL=2
CONFIG_NET_CONFIG_IEEE802154_PAN_ID=0xABCD

# --- Gestión de red ---
CONFIG_NET_MGMT=y

CONFIG_NET_MGMT_EVENT=y
CONFIG_NET_MGMT_EVENT_INFO=y
CONFIG_NET_DEFAULT_IF_IEEE802154=y

# --- Logging y depuración ---
CONFIG_LOG=n
CONFIG_NET_LOG=n
CONFIG_LOG_DEFAULT_LEVEL=0
CONFIG_IEEE802154_DRIVER_LOG_LEVEL_DBG=n
CONFIG_NET_L2_IEEE802154_LOG_LEVEL_DBG=n

# --- Buffers ---
CONFIG_NET_PKT_RX_COUNT=16
CONFIG_NET_PKT_TX_COUNT=16
CONFIG_NET_BUF_RX_COUNT=64
CONFIG_NET_BUF_TX_COUNT=64
CONFIG_NET_CONTEXT_NET_PKT_POOL=y

# --- Consola shell ---
CONFIG_SHELL=y
CONFIG_NET_L2_IEEE802154_SHELL=y

# --- Tamaños de pila ---
CONFIG_MAIN_STACK_SIZE=2048
CONFIG_SYSTEM_WORKQUEUE_STACK_SIZE=2048


CONFIG_IEEE802154_CC13XX_CC26XX_SUB_GHZ=y
CONFIG_GPIO=y
CONFIG_POSIX_API=y

CONFIG_IEEE802154_CC13XX_CC26XX_SUB_GHZ_CS_THRESHOLD=-100
```

## src/main.c
```c
#include <zephyr/kernel.h>
#include <zephyr/net/socket.h>
#include <zephyr/sys/printk.h>
#include <zephyr/sys/sem.h>
#include <zephyr/net/net_if.h>
#include <zephyr/net/net_mgmt.h>
#include <zephyr/net/ieee802154_mgmt.h>
#include <zephyr/drivers/gpio.h>
#include <string.h>
#include <errno.h>
#include <fcntl.h>

#define SERVER_PORT 12345
#define BUFFER_SIZE 128
#define RESPONSE_MESSAGE "Y el corazon tucun tucun tucun"
#define THREAD_STACK_SIZE 1024
#define THREAD_PRIORITY 5

static struct k_sem sync_sem;
static char recv_buffer[BUFFER_SIZE];
static struct sockaddr_in6 client_addr;
static socklen_t client_addr_len;
static int server_sock;

static int set_tx_power(struct net_if *iface, int16_t dbm)
{
    struct {
        int16_t dbm;
    } tx_power = {
        .dbm = dbm
    };
    
    int ret = net_mgmt(NET_REQUEST_IEEE802154_SET_TX_POWER,
                       iface, &tx_power, sizeof(tx_power));
    if (ret) {
        printk("Failed to set TX power to %d dBm: %d\n", dbm, ret);
        return ret;
    }

    printk("TX power set to %d dBm\n", dbm);
    return 0;
}

K_THREAD_STACK_DEFINE(receive_stack, THREAD_STACK_SIZE);
K_THREAD_STACK_DEFINE(transmit_stack, THREAD_STACK_SIZE);
struct k_thread receive_thread_data;
struct k_thread transmit_thread_data;

void receive_thread(void *arg1, void *arg2, void *arg3)
{
    ssize_t received;

    while (1) {
        memset(recv_buffer, 0, BUFFER_SIZE);
        client_addr_len = sizeof(client_addr);

        received = recvfrom(server_sock, recv_buffer, BUFFER_SIZE - 1, 0,
                            (struct sockaddr *)&client_addr, &client_addr_len);
        
        if (received < 0) {
            if (errno != EAGAIN && errno != EWOULDBLOCK) {
                printk("Failed to receive data: %d (%s)\n", errno, strerror(errno));
            }
            // EAGAIN/EWOULDBLOCK es normal con non-blocking
            k_sleep(K_MSEC(50));
            continue;
        }

        recv_buffer[received] = '\0';
        printk("Received %zd bytes from client: %s\n", received, recv_buffer);

        k_sem_give(&sync_sem);
    }
}

void transmit_thread(void *arg1, void *arg2, void *arg3)
{
    ssize_t sent;

    while (1) {
        k_sem_take(&sync_sem, K_FOREVER);

        sent = sendto(server_sock, RESPONSE_MESSAGE, strlen(RESPONSE_MESSAGE), 0,
                      (struct sockaddr *)&client_addr, client_addr_len);
        
        if (sent < 0) {
            if (errno != EAGAIN && errno != EWOULDBLOCK) {
                printk("Failed to send response: %d (%s)\n", errno, strerror(errno));
            }
        } else {
            printk("Response sent to client (%zd bytes)\n", sent);
        }

        k_sleep(K_MSEC(100));
    }
}

void main(void)
{
    struct sockaddr_in6 server_addr;
    struct net_if *iface;
    int flags;

    printk("Starting UDP server with semaphore synchronization\n");

    iface = net_if_get_default();
    if (!iface) {
        printk("No default net interface\n");
        return;
    }

    net_if_up(iface);
    k_sleep(K_MSEC(1500));
    
    set_tx_power(iface, 20);

    k_sem_init(&sync_sem, 0, 1);

    server_sock = socket(AF_INET6, SOCK_DGRAM, IPPROTO_UDP);
    if (server_sock < 0) {
        printk("Failed to create socket: %d\n", errno);
        return;
    }
    printk("Socket created successfully\n");

    // Hacer el socket non-blocking
    flags = fcntl(server_sock, F_GETFL, 0);
    if (flags < 0) {
        printk("Failed to get socket flags: %d\n", errno);
        close(server_sock);
        return;
    }
    
    if (fcntl(server_sock, F_SETFL, flags | O_NONBLOCK) < 0) {
        printk("Failed to set non-blocking: %d\n", errno);
        close(server_sock);
        return;
    }
    printk("Socket set to non-blocking mode\n");

    memset(&server_addr, 0, sizeof(server_addr));
    server_addr.sin6_family = AF_INET6;
    server_addr.sin6_port = htons(SERVER_PORT);
    server_addr.sin6_addr = in6addr_any;

    if (bind(server_sock, (struct sockaddr *)&server_addr, sizeof(server_addr)) < 0) {
        printk("Failed to bind socket: %d\n", errno);
        close(server_sock);
        return;
    }
    printk("Socket bound to port %d\n", SERVER_PORT);

    k_thread_create(&receive_thread_data, receive_stack, THREAD_STACK_SIZE,
                    receive_thread, NULL, NULL, NULL,
                    THREAD_PRIORITY, 0, K_NO_WAIT);

    k_thread_create(&transmit_thread_data, transmit_stack, THREAD_STACK_SIZE,
                    transmit_thread, NULL, NULL, NULL,
                    THREAD_PRIORITY, 0, K_NO_WAIT);

    while (1) {
        k_sleep(K_FOREVER);
    }
}
```
