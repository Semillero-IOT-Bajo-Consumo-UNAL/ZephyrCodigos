## Comandos/Nivel_0_LED/build/Kconfig/boards/Kconfig.defconfig
```kconfig
# Load Zephyr board defconfig descriptions.
osource "/home/ash/zephyrproject/zephyr/boards/beagle/beagleconnect_freedom/Kconfig.defconfig"
```

## Comandos/Subcomando_Estatico_LED/build/Kconfig/boards/Kconfig.beagleconnect_freedom
```kconfig
# Load board Kconfig descriptions.
osource "/home/ash/zephyrproject/zephyr/boards/beagle/beagleconnect_freedom/Kconfig.beagleconnect_freedom"
```

## Comunicaciones/IEEE_802.15.4/build/Kconfig/boards/Kconfig
```kconfig
# Load Zephyr board Kconfig descriptions.
osource "/home/ash/zephyrproject/zephyr/boards/beagle/beagleconnect_freedom/Kconfig"
```

## Comunicaciones/IEEE_802.15.4/build/Kconfig/boards/Kconfig.sysbuild
```kconfig
# Load Sysbuild board Kconfig descriptions.
osource "/home/ash/zephyrproject/zephyr/boards/beagle/beagleconnect_freedom/Kconfig.sysbuild"
```

## Hola_Mundo/build/Kconfig/arch/Kconfig
```kconfig
# Load Zephyr Arch Kconfig descriptions.
osource "/home/ash/zephyrproject/zephyr/arch/x86/Kconfig"
osource "/home/ash/zephyrproject/zephyr/arch/xtensa/Kconfig"
osource "/home/ash/zephyrproject/zephyr/arch/sparc/Kconfig"
osource "/home/ash/zephyrproject/zephyr/arch/riscv/Kconfig"
osource "/home/ash/zephyrproject/zephyr/arch/posix/Kconfig"
osource "/home/ash/zephyrproject/zephyr/arch/nios2/Kconfig"
osource "/home/ash/zephyrproject/zephyr/arch/mips/Kconfig"
osource "/home/ash/zephyrproject/zephyr/arch/arm64/Kconfig"
osource "/home/ash/zephyrproject/zephyr/arch/arm/Kconfig"
osource "/home/ash/zephyrproject/zephyr/arch/arc/Kconfig"
```
