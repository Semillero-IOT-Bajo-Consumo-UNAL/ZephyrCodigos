## prj.conf
```kconfig
CONFIG_NETWORKING=y
CONFIG_NET_L2_OPENTHREAD=y
CONFIG_OPENTHREAD_COAP=y
CONFIG_OPENTHREAD_SLAAC=y
CONFIG_JSON_LIBRARY=y

# Logging
CONFIG_LOG=y
CONFIG_LOG_MAX_LEVEL=1
CONFIG_LOG_MODE_MINIMAL=n
CONFIG_BOOT_BANNER=y
CONFIG_LOG_BACKEND_UART=y

# Kernel options
CONFIG_MAIN_STACK_SIZE=2560
CONFIG_INIT_STACKS=y

# Add features required for FTD CLI
CONFIG_SHELL=y
CONFIG_OPENTHREAD_SHELL=y
CONFIG_OPENTHREAD_PING_SENDER=y

# Network config
CONFIG_OPENTHREAD_PANID=4660
CONFIG_OPENTHREAD_XPANID="11:11:11:11:22:22:22:22"
CONFIG_OPENTHREAD_NETWORKKEY="00:11:22:33:44:55:66:77:88:99:aa:bb:cc:dd:ee:ff"
CONFIG_OPENTHREAD_CHANNEL=15
CONFIG_OPENTHREAD_NETWORK_NAME="OpenThreadDemo"


CONFIG_NET_IPV6=y
CONFIG_NET_UDP=y
CONFIG_NET_SOCKETS=y
```

## src/main.c
```c
#include <zephyr/kernel.h>
#include <zephyr/net/socket.h>
#include <zephyr/net/net_context.h>
#include <zephyr/net/net_pkt.h>
#include <zephyr/net/net_ip.h>
#include <zephyr/shell/shell.h>
static struct net_context *udp_context;
/*
Eventos
*/

static void udp_receive(struct net_context *context, struct net_pkt *pkt,int status, void *user_data){
    ARG_UNUSED(context);
    ARG_UNUSED(user_data);
    ARG_UNUSED(status);

    size_t len = net_pkt_remaining_data(pkt);
    uint8_t buf[len + 1];

    if (net_pkt_read(pkt, buf, len) < 0) {
        printk("Failed to read UDP payload\n");
        net_pkt_unref(pkt);
        return;
    }

    buf[len] = '\0'; // Null-terminate
    printk("Received UDP message (len %zu): %s\n", len, buf);

    net_pkt_unref(pkt);
}


int udp_send(const char *msg, const char *dest_ip, uint16_t dest_port)
{
    struct sockaddr_in6 dest_addr = { 0 };
    int ret;

    // Configura dirección destino
    dest_addr.sin6_family = AF_INET6;
    dest_addr.sin6_port = htons(dest_port);

    ret = net_addr_pton(AF_INET6, dest_ip, &dest_addr.sin6_addr);
    if (ret < 0) {
        printk("Invalid IPv6 address: %s\n", dest_ip);
        return ret;
    }

    // Envía directamente el buffer como mensaje UDP
    ret = net_context_sendto(udp_context,
                             msg,
                             strlen(msg),
                             (struct sockaddr *)&dest_addr,
                             sizeof(dest_addr),
                             NULL,         // callback
                             K_NO_WAIT,    // timeout
                             NULL);        // user_data
    if (ret < 0) {
        printk("UDP send failed: %d\n", ret);
    }

    return ret;
}

/*
Cuerpo principal
*/

static int comunicarf(const struct shell *shell, size_t argc, char **argv)
{
    if (argc < 2) {
        shell_print(shell, "Uso: comunicar <mensaje>");
        return -EINVAL;
    }

    const char *msg = argv[1];
    udp_send(msg, "ff03::1", 12345);
    return 0;
}

static int mensajef(const struct shell *shell, size_t argc, char **argv)
{
    if (argc < 3) {
        shell_print(shell, "Uso: mensaje <ip> <mensaje>");
        return -EINVAL;
    }
    const char *ip = argv[1];
    const char *msg = argv[2];
    udp_send(msg, ip, 12345);
    return 0;
}


void main(void)
{
    // Obtenemos el contexto UDP
    net_context_get(AF_INET6, SOCK_DGRAM, IPPROTO_UDP, &udp_context);

    // "Bindeamos" el puerto 12345 para recibir y enviar los datos
    struct sockaddr_in6 local_addr = { 0 };
    local_addr.sin6_family = AF_INET6;
    local_addr.sin6_port = htons(12345);
    local_addr.sin6_addr = in6addr_any;
    net_context_bind(udp_context, (struct sockaddr *)&local_addr,sizeof(local_addr));

    // Cuando recibimos datos los mandamos a udp_receive_cb
    net_context_recv(udp_context, udp_receive, K_NO_WAIT, NULL);


}
SHELL_CMD_REGISTER(comunicar, NULL, "Envia un mesaje a toda la red (ej: comunicar hola_mundo)", comunicarf);
SHELL_CMD_REGISTER(mensaje, NULL, "Envia un mesaje a una ip en especifico (con <ot ipaddr> puedes ver tu ip)", mensajef);
```
