## prj.conf
```kconfig
# --- Núcleo de red ---
CONFIG_NETWORKING=y
CONFIG_NET_UDP=y
CONFIG_NET_TCP=n
CONFIG_NET_IPV6=y
CONFIG_NET_IPV4=n
CONFIG_NET_SOCKETS=y
CONFIG_NET_SOCKETS_PACKET=y
CONFIG_POSIX_API=y
CONFIG_REQUIRES_FULL_LIBC=y
CONFIG_NET_SOCKETS_POLL_MAX=4

# --- Configuración de red ---
CONFIG_NET_CONFIG_SETTINGS=y
CONFIG_NET_CONNECTION_MANAGER=y
CONFIG_NET_CONFIG_NEED_IPV6=y
CONFIG_NET_CONFIG_MY_IPV6_ADDR="2001:db8::1"
CONFIG_NET_CONFIG_PEER_IPV6_ADDR="2001:db8::2"
CONFIG_NET_IF_MCAST_IPV6_ADDR_COUNT=5

# --- Capa IEEE 802.15.4 ---
CONFIG_NET_L2_IEEE802154=y
CONFIG_IEEE802154=y

# Canal y PAN ID (canal sub-GHz según tabla 802.15.4g para tu región)
CONFIG_NET_CONFIG_IEEE802154_CHANNEL=0
CONFIG_NET_CONFIG_IEEE802154_PAN_ID=0xABCD
# --- Gestión de red ---
CONFIG_NET_MGMT=y

CONFIG_NET_MGMT_EVENT=y
CONFIG_NET_MGMT_EVENT_INFO=y
CONFIG_NET_DEFAULT_IF_IEEE802154=y

# --- Logging y depuración ---
CONFIG_LOG=y
CONFIG_NET_LOG=y
CONFIG_LOG_DEFAULT_LEVEL=3
CONFIG_IEEE802154_DRIVER_LOG_LEVEL_DBG=y
CONFIG_NET_L2_IEEE802154_LOG_LEVEL_DBG=y

# --- Buffers ---
CONFIG_NET_PKT_RX_COUNT=16
CONFIG_NET_PKT_TX_COUNT=16
CONFIG_NET_BUF_RX_COUNT=64
CONFIG_NET_BUF_TX_COUNT=64
CONFIG_NET_CONTEXT_NET_PKT_POOL=y

# --- Consola shell ---
CONFIG_SHELL=y
CONFIG_NET_L2_IEEE802154_SHELL=y

# --- Tamaños de pila ---
CONFIG_MAIN_STACK_SIZE=2048
CONFIG_SYSTEM_WORKQUEUE_STACK_SIZE=2048


CONFIG_IEEE802154_CC13XX_CC26XX_SUB_GHZ=y
```

## src/main.c
```c
#include <zephyr/kernel.h>
#include <zephyr/net/socket.h>
#include <zephyr/sys/printk.h>
#include <zephyr/sys/sem.h>

#define SERVER_PORT 12345         // Server listening port
#define BUFFER_SIZE 128           // Buffer size for incoming messages
#define RESPONSE_MESSAGE "Hello from server!"

#define THREAD_STACK_SIZE 1024    // Stack size for threads
#define THREAD_PRIORITY 5         // Priority for threads

static struct k_sem sync_sem;     // Semaphore for synchronizing receive and transmit
static char recv_buffer[BUFFER_SIZE]; // Buffer to store received messages
static struct sockaddr_in6 client_addr; // Client address
static socklen_t client_addr_len;
static int server_sock;          // Server socket
const struct device *radio = DEVICE_DT_GET(DT_NODELABEL(cc13xx_cc26xx_ieee802154));
// Thread stack and thread definitions
K_THREAD_STACK_DEFINE(receive_stack, THREAD_STACK_SIZE);
K_THREAD_STACK_DEFINE(transmit_stack, THREAD_STACK_SIZE);
K_THREAD_STACK_DEFINE(msg_stack, THREAD_STACK_SIZE);
struct k_thread receive_thread_data;
struct k_thread transmit_thread_data;
struct k_thread msg_data;

void receive_thread(void *arg1, void *arg2, void *arg3) {
    ssize_t received;

    while (1) {
        memset(recv_buffer, 0, BUFFER_SIZE);
        client_addr_len = sizeof(client_addr);

        // Wait for data from a client
        received = recvfrom(server_sock, recv_buffer, BUFFER_SIZE - 1, 0,
                            (struct sockaddr *)&client_addr, &client_addr_len);
        if (received < 0) {
            printk("Failed to receive data: %d\n", errno);
            continue;
        }

        // Null-terminate the received data for printing
        recv_buffer[received] = '\0';
        printk("Received %zd bytes from client: %s\n", received, recv_buffer);

        // Signal the transmit thread to send a response
        k_sem_give(&sync_sem);
    }
}


void transmit_thread(void *arg1, void *arg2, void *arg3) {
    ssize_t sent;

    while (1) {
        // Wait for the semaphore to be given by the receive thread
        k_sem_take(&sync_sem, K_FOREVER);

        // Respond to the client
        sent = sendto(server_sock, RESPONSE_MESSAGE, strlen(RESPONSE_MESSAGE), 0,
                      (struct sockaddr *)&client_addr, client_addr_len);
        if (sent < 0) {
            printk("Failed to send response: %d\n", errno);
        } else {
            printk("Response sent to client\n");
        }

        // Add a small delay to avoid flooding the network
        k_sleep(K_MSEC(100));
    }
}

void main(void) {
    struct sockaddr_in6 server_addr;

    printk("Starting UDP server with semaphore synchronization\n");

    // Initialize semaphore
    k_sem_init(&sync_sem, 0, 1);

    // Create a UDP socket
    server_sock = socket(AF_INET6, SOCK_DGRAM, IPPROTO_UDP);
    if (server_sock < 0) {
        printk("Failed to create socket: %d\n", errno);
        return;
    }
    printk("Socket created successfully\n");
    printk("AF_INET6 = %d\n", AF_INET6);
    printk("SOCK_DGRAM = %d\n", SOCK_DGRAM);
    printk("IPPROTO_UDP = %d\n", IPPROTO_UDP);
    

    // Configure the server address
    memset(&server_addr, 0, sizeof(server_addr));
    server_addr.sin6_family = AF_INET6;
    server_addr.sin6_port = htons(SERVER_PORT);
    server_addr.sin6_addr = in6addr_any;

    // Bind the socket to the server address and port
    if (bind(server_sock, (struct sockaddr *)&server_addr, sizeof(server_addr)) < 0) {
        printk("Failed to bind socket: %d\n", errno);
        close(server_sock);
        return;
    }
    printk("Socket bound to port %d\n", SERVER_PORT);

    // Start the receive thread
    k_thread_create(&receive_thread_data, receive_stack, THREAD_STACK_SIZE,
                    receive_thread, NULL, NULL, NULL,
                    THREAD_PRIORITY, 0, K_NO_WAIT);

    // Start the transmit thread
    k_thread_create(&transmit_thread_data, transmit_stack, THREAD_STACK_SIZE,
                    transmit_thread, NULL, NULL, NULL,
                    THREAD_PRIORITY, 0, K_NO_WAIT);
}
```
