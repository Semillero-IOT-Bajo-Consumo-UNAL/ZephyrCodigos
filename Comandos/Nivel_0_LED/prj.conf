## CMakeLists.txt
```
# Indicamos la version minima de CMAKE
cmake_minimum_required(VERSION 3.20.0)

# Imporamos Zephyr como obligatorio
find_package(Zephyr REQUIRED)

# Le ponemos nombre a nuestro proyecto ( puramente para informacion )
project(Blinky_CMD)

# si vamos a incluir mas librerias descomentamos e indicamos la carpeta de los .h
# target_include_directories(app PRIVATE libreria/carpeta/include/)

# Indicamos los archivos de NUESTRO proyecto vamos a compilar
target_sources(app PRIVATE src/main.c)
```

## prj.conf
```kconfig
CONFIG_SHELL=y
CONFIG_PRINTK=y
CONFIG_GPIO=y
```

## src/main.c
```c
#include <zephyr/shell/shell.h>
#include <zephyr/drivers/gpio.h>

// Definimos el led que vamos a usar
#define LED_NODE DT_ALIAS(led0)
static const struct gpio_dt_spec led = GPIO_DT_SPEC_GET(LED_NODE, gpios);

// Definimos que se va a ejecutar cuando el usuario mande el comando
static int cmd_led_on(const struct shell *shell, size_t argc, char **argv)
{
    // Conmutamos el led de la beagle cuando se ejecute el comando
    gpio_pin_toggle_dt(&led);
    return 0;
}

// Inicializamos nuestro led
int main(){
    gpio_pin_configure_dt(&led, GPIO_OUTPUT_ACTIVE);
    return 0;
}

// Registramos el comando con (NombreComando,NULL,Descripcion del comando, Funcion)
SHELL_CMD_REGISTER(prenderLed, NULL, "Enciende un LED", cmd_led_on);
```
